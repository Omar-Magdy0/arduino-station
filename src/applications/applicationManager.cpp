#include "applicationManager.h"
#include "Configuration.h"


// Menu Grid is like that 
// 1st box 128x20px 
// 2nd box 128x20px (has white rectangle)
// 3rd box 128x20px 

//Menu Items 


#ifndef CUSTOMMAINMENU
#define App1 application("APP1",maintenance)
#define App2 application("APP2",maintenance)
#define App3 application("APP3",maintenance)
#define App4 application("APP4",maintenance)
#define App5 application("APP5",maintenance)
#define App6 application("APP6",maintenance)
#define appMenuSize 6
application menuApps[appMenuSize] = {
App1,
App2,
App3,
App4,
App5,
App6,
};
#endif



/*
                 | 	 MMJO	 |   APRNNG  |  PGCHNG  |   MNUI3   |   MNUI2   |   MNUI1   |   MNUI0   |
APMNGCTRL        |     0     |     0     |     0    |     0     |     0     |     0     |     0     |    


=============== bit 0:3   MENU index bits
               |   MNUI3   |   MNUI2   |   MNUI1   |   MNUI0   |
    APP0       |     0     |     0     |     0     |     0     |
    APP1       |     0     |     0     |     0     |     1     |
    APP2       |     0     |     0     |     1     |     0     |
    APP3       |     0     |     0     |     1     |     1     |
    APP4       |     0     |     1     |     0     |     0     |
    APP5       |     0     |     1     |     0     |     1     |
    APP6       |     0     |     1     |     1     |     0     |
and soo on

			  COULD be used like this for integer operations
			  int16_t dummyByte = 0b000000;
			  dummyByte |= (1<<MNUI3) | (1<<MNUI2) | (1<<MNUI1) | (1<<MNUI0);  
				NOW you have integer for the last 4 bits


=== bit 4 (APPCSNG) represents app Closting State
=== bit 5 (APJSTRN) represents app Just Run State
=== bit 6 (PGCHNG) represents app is running state
=== bit 7 (MMJO) represents app Just Run State

*/
uint8_t APMNGCTRL = (1<<MMJO) ;
#define MNUI0 	0
#define MNUI1 	1
#define MNUI2 	2
#define MNUI3 	3
#define PGCHNG 	4
#define APRNNG  5
#define MMJO 	6


// POINTS TO THE application function
void(*appFunction)() = nullptr;

int8_t appMenuIndexer(int8_t num){
    if(num > (appMenuSize - 1)){num = 0;}
    else if(num < 0){num = (appMenuSize - 1);}    
    return num;
}


void applicationManager(){
	int8_t menuIndex = 0b000000;
	menuIndex |= APMNGCTRL & ((1<<MNUI3) | (1<<MNUI2) | (1<<MNUI1) | (1<<MNUI0)); 


//HERE FUNCTIONS FOR WHEN BUTTON ACTION DETECTED
	uint16_t potReading = readPot();
	uint8_t clickType = potButtonComb(potReading);
	controlUI(potReading);
	if(clickType == IPGINDIC){
		menuIndex++;APMNGCTRL &= 0b11110000;
		if(menuIndex > (appMenuSize - 1))
			menuIndex = 0;
		APMNGCTRL |= menuIndex;APMNGCTRL |= (1<<PGCHNG);
		}
	else if(clickType == IPGINDDC){
		menuIndex--;APMNGCTRL &= 0b11110000;
		if(menuIndex < 0)
			menuIndex = appMenuSize - 1;
		APMNGCTRL |= menuIndex;APMNGCTRL |= (1<<PGCHNG);
		}
	else if(clickType == APPCLOOP){
		APMNGCTRL |= ((1<<MMJO) | (1<<APRNNG));
		appFunction = menuApps->getAppMainFunc();
		return;
		}
//GRAPHICS PART ONLY OPTIMIZABLE

	if( (APMNGCTRL & (1<<MMJO)) || (APMNGCTRL & (1<<PGCHNG)) ){

		TextBox box1 = TextBox(menuApps[appMenuIndexer(menuIndex - 1)].getName(),1);
		TextBox box2 = TextBox(menuApps[appMenuIndexer(menuIndex)].getName(),1);
		TextBox box3 = TextBox(menuApps[appMenuIndexer(menuIndex + 1)].getName(),1);
		box1.textRectCenterer(0,10,128,18);
		box2.textRectCenterer(0,28,128,18);
		box3.textRectCenterer(0,46,128,18);
		
		auto displayFunction = [&box1,&box2,&box3](){
			Screen.clearPage(BLACK);
			box1.display();
			Screen.setTextColor(BLACK);
			Screen.drawFillRect(0,28,128,18,WHITE);
			box2.display();
			Screen.setTextColor(WHITE);
			box3.display();
		};
		
		Screen.displayFunctionGroup(1,7,displayFunction);

	    APMNGCTRL &= ~(1<<MMJO);
		APMNGCTRL &= ~(1<<PGCHNG);
}
}

//maintenance Screen
// 'MAINTENANCE SCREEN', 128x42px
const unsigned char maintenanceScreen [] PROGMEM = {
	0x00, 0x00, 0x00, 0x00, 0x00, 0x00, 0x00, 0x00, 0x00, 0x00, 0x00, 0x00, 0x00, 0x00, 0x00, 0x00, 
	0x00, 0x00, 0x00, 0x00, 0x00, 0x00, 0x00, 0x00, 0x00, 0x00, 0x00, 0x00, 0x00, 0x00, 0x00, 0x00, 
	0x00, 0x00, 0x00, 0x00, 0x00, 0x00, 0x00, 0x00, 0x00, 0x00, 0x00, 0x00, 0x00, 0x00, 0x00, 0x00, 
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	0x01, 0x01, 0x01, 0x00, 0x00, 0x00, 0x00, 0x00, 0x00, 0x00, 0x00, 0x00, 0x00, 0x00, 0x00, 0x00

};

void maintenance(){
	auto displayFunction = [](){
		Screen.clearPage(BLACK);
		Screen.drawBitMap(maintenanceScreen,0,10,128,42,WHITE,true);
	};
	uint16_t potReading = readPot();
	controlUI(potReading);
	Screen.displayFunctionGroup(1,7,displayFunction);
	if(potButtonComb(potReading) == APPCLOOP){
	//do whatever you want before closing app
		APMNGCTRL &= ~(1<<APRNNG);
	}
}







